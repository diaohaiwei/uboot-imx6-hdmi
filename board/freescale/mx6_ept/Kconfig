## board/freescale/mx6_ept/Kconfig
```kconfig
if TARGET_MX6_EPT

config SYS_BOARD
	default "mx6_ept"

config SYS_VENDOR
	default "freescale"

config SYS_SOC
	default "mx6"

config SYS_CONFIG_NAME
	default "mx6_ept"

endif
```

## configs/mx6q_ept_defconfig
```kconfig
CONFIG_SYS_EXTRA_OPTIONS="IMX_CONFIG=board/freescale/mx6_ept/mx6q_4x.cfg,MX6Q,SYS_USE_SPINOR"
CONFIG_ARM=y
CONFIG_TARGET_MX6_EPT=y
CONFIG_DM=y
CONFIG_DM_THERMAL=y
```
